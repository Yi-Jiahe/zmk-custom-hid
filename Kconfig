## boards/shields/tentatwo/Kconfig.defconfig
```kconfig
if SHIELD_TENTATWO

# Name must be less than 16 characters long!
config ZMK_KEYBOARD_NAME
    default "TentaTwo"

endif
```

## boards/shields/tentatwo/Kconfig.shield
```kconfig
# No whitespace after the comma or in your keyboard name!
config SHIELD_TENTATWO
    def_bool $(shields_list_contains,tentatwo)
```

## dts/bindings/behaviors/zmk,behavior-tentatwo.yaml
```yaml
description: TentaTwo behavior

compatible: "zmk,behavior-tentatwo"

include: one_param.yaml
```
