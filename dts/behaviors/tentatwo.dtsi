#include <dt-bindings/zmk/behaviors.h>

/ {
  behaviors {
    /omit-if-no-ref/ tentatwo: tentatwo {
      compatible = "zmk,behavior-tentatwo";
      #binding-cells = <1>;
      display-name = "TentaTwo";
    };
  };
};
